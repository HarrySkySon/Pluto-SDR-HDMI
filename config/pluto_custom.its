## config/pluto_custom.its
```
/dts-v1/;

/ {
    description = "Configuration to load fpga before Kernel";
    #address-cells = <0x01>;

    images {
        kernel@1 {
            description = "Linux kernel";
            data = /incbin/("/home/kali/linux/arch/arm/boot/zImage");
            type = "kernel";
            arch = "arm";
            os = "linux";
            compression = "none";
            load = <0x8000>;
            entry = <0x8000>;
        };
        
        fdt@1 {
            description = "Pluto device tree blob";
            data = /incbin/("pluto.dtb");
            type = "flat_dt";
            arch = "arm";
            compression = "none";
        };
		
		fdt@2 {
            description = "Pluto device tree blob";
            data = /incbin/("pluto.dtb");
            type = "flat_dt";
            arch = "arm";
            compression = "none";
        };
		
		fdt@3 {
            description = "Pluto device tree blob";
            data = /incbin/("pluto.dtb");
            type = "flat_dt";
            arch = "arm";
            compression = "none";
        };
        
        fpga@1 {
            description = "FPGA bitstream";
            data = /incbin/("fpga.bit");
            type = "fpga";
            arch = "arm";
            compression = "none";
            load = <0x0f000000>;
        };
        
        ramdisk@1 {
            description = "Initial ramdisk";
            data = /incbin/("ramdisk.img.gz");
            type = "ramdisk";
            arch = "arm";
            os = "linux";
            compression = "gzip";
        };
    };

    configurations {
        default = "config@0";

		config@0 {
			description = "Linux with fpga RevA";
			fdt = "fdt@1";
			kernel = "linux_kernel@1";
			ramdisk = "ramdisk@1";
			fpga = "fpga@1";
		};

		config@1 {
			description = "Linux with fpga RevB";
			fdt = "fdt@2";
			kernel = "linux_kernel@1";
			ramdisk = "ramdisk@1";
			fpga = "fpga@1";
		};

		config@2 {
			description = "Linux with fpga RevB";
			fdt = "fdt@2";
			kernel = "linux_kernel@1";
			ramdisk = "ramdisk@1";
			fpga = "fpga@1";
		};

		config@3 {
			description = "Linux with fpga RevB";
			fdt = "fdt@2";
			kernel = "linux_kernel@1";
			ramdisk = "ramdisk@1";
			fpga = "fpga@1";
		};

		config@4 {
			description = "Linux with fpga RevB";
			fdt = "fdt@2";
			kernel = "linux_kernel@1";
			ramdisk = "ramdisk@1";
			fpga = "fpga@1";
		};

		config@5 {
			description = "Linux with fpga RevB";
			fdt = "fdt@2";
			kernel = "linux_kernel@1";
			ramdisk = "ramdisk@1";
			fpga = "fpga@1";
		};

		config@6 {
			description = "Linux with fpga RevB";
			fdt = "fdt@2";
			kernel = "linux_kernel@1";
			ramdisk = "ramdisk@1";
			fpga = "fpga@1";
		};

		config@7 {
			description = "Linux with fpga RevB";
			fdt = "fdt@2";
			kernel = "linux_kernel@1";
			ramdisk = "ramdisk@1";
			fpga = "fpga@1";
		};

		config@8 {
			description = "Linux with fpga RevC";
			fdt = "fdt@3";
			kernel = "linux_kernel@1";
			ramdisk = "ramdisk@1";
			fpga = "fpga@1";
		};

		config@9 {
			description = "Linux with fpga RevB";
			fdt = "fdt@3";
			kernel = "linux_kernel@1";
			ramdisk = "ramdisk@1";
			fpga = "fpga@1";
		};

		config@10 {
			description = "Linux with fpga RevB";
			fdt = "fdt@2";
			kernel = "linux_kernel@1";
			ramdisk = "ramdisk@1";
			fpga = "fpga@1";
		};
    };
};
```
